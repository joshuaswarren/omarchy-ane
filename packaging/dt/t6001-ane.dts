// SPDX-License-Identifier: GPL-2.0+ OR MIT
/*
 * ANE for T6001 (M1 Max) board device trees, for kernels whose trees lack it.
 * Tested: the nodes of t600x-ane.dtsi bound ane.ko and ran exact fp16
 * programs on the M1 Max host.
 */
/dts-v1/;
/plugin/;

/ {
	/* dtb-overlays.sh: a kernel tree that has the node keeps its own. */
	omarchy,skip-if-compatible = "apple,t6000-ane";
};

/include/ "t600x-ane.dtsi"
