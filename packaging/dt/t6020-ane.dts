// SPDX-License-Identifier: GPL-2.0+ OR MIT
/*
 * ANE for T6020 (M2 Pro) board device trees. OPT-IN, UNTESTED: it applies only
 * after the owner adds "ane-t6020" to /etc/omarchy-platform/dtb-overlays.opt-in.
 * The node values are the T6021 ones (t602x-ane.dtsi, same in the macOS 13.5
 * ADTs of j414s, j416s and j474s), and the 13.5 BuildManifest gives these
 * boards the same ANE firmware (t602x_ane0_fw_selene_rc4x). ane_t6021 binds
 * apple,t6020-ane and runs that firmware from memory it allocates, with
 * iBoot's runtime patches replayed (ane/t6021/ane_fw_validate.h), so no
 * preload address and no reserved-memory node is needed. RTK_soc is 0x6020,
 * the chip revision 0x01 (ANEMinorVersion 1 on community rows 4e8224a39f40,
 * dc53badc436a, ea8c35bd20bf, e6069fe959ad; receipts/2026-10-01-community-rows),
 * and the ASC tunables are the T6020 table of the macOS 26.6.2 iBoot of j414s
 * and j416s, which differs from T6021 in 13 of 24 values
 * (receipts/2026-10-01-t8112-optin). No T6020 has run it.
 */
/dts-v1/;
/plugin/;

/ {
	/* dtb-overlays.sh: a kernel tree that has the node keeps its own. */
	omarchy,skip-if-compatible = "apple,t6020-ane";
	/* dtb-overlays.sh: applies only when opted in. */
	omarchy,opt-in = "ane-t6020";
};

/include/ "t602x-ane.dtsi"

/ {
	fragment@10 {
		__overlay__ {
			ane@284000000 {
				compatible = "apple,t6020-ane";
			};
		};
	};
};
