// SPDX-License-Identifier: GPL-2.0+ OR MIT
/*
 * Overlay state: on by default (row 316ea37e17f0; dkms; die 0 only on driver 0.5.6; kernel 7.1.13 with the ANE DART power-domain change (#278)).
 * ANE for T6022 (M2 Ultra) board device trees: the die-0 ANE only. Die 0 has
 * the T6021 values
 * (t602x-ane.dtsi, same in the macOS 13.5 ADTs of j180d and j475d), and the
 * 13.5 firmware list gives ANE0 the same firmware (t602x_ane0_fw_selene_rc4x).
 * ane_t6021 binds apple,t6022-ane and runs that firmware from memory it
 * allocates, with iBoot's runtime patches replayed (ane/t6021/ane_fw_validate.h),
 * so no preload address and no reserved-memory node is needed. RTK_soc is
 * 0x6022, the chip revision 0x11 (ANEMinorVersion 17 on community row
 * 90c6b9bf3e03), and the ASC tunables are the T6021 values: the macOS 26.6.2
 * iBoot of j180d and j475d holds the same ANE table as j414c
 * (receipts/2026-10-01-t8112-optin).
 *
 * The die-1 ANE (ADT ane1: 0x2284000000, interrupt 884 on die 1, DARTs at
 * 0x2285800000, firmware t602x_ane1_fw_selene_rc4x) is left out: ane_t6021
 * drives one ANE, and its T6022 data (ane_t6022_soc in
 * ane/t6021/ane_t6021_fwload.c: the pmgr page 0x28e084000) is die 0's.
 */
/dts-v1/;
/plugin/;

/ {
	/* dtb-overlays.sh: a kernel tree that has the node keeps its own. */
	omarchy,skip-if-compatible = "apple,t6022-ane";
};

/include/ "t602x-ane.dtsi"

/ {
	fragment@10 {
		__overlay__ {
			ane@284000000 {
				compatible = "apple,t6022-ane";
			};

			/*
			 * The three DARTs take their power from ANE_SYS (pmgr 0x260) on
			 * T6022. In the live macOS 15 IORegistry of a J475d, dart-ane0
			 * (all three windows) has power-gates 0x1fb, which pmgr's device
			 * table names ANE-SYS-DART, a gate without registers under 0x3c
			 * ANE_SYS. With dart0 in pmp, the J475d panicked at boot with an
			 * asynchronous SError in apple_dart_probe (7.1.13); with all three
			 * in ANE_SYS it boots, the DARTs initialize and ane_t6021's smoke
			 * run passes 20/20 (receipts/2026-10-29-t6022-j475d-ane-sys).
			 */
			iommu@285800000 {
				power-domains = <&ps_ane_sys>;
			};

			iommu@285810000 {
				power-domains = <&ps_ane_sys>;
			};

			iommu@285820000 {
				power-domains = <&ps_ane_sys>;
			};
		};
	};

	fragment@12 {
		target-path = "/soc/power-management@28e080000/power-controller@260";
		ps_ane_sys: __overlay__ {
		};
	};
};
