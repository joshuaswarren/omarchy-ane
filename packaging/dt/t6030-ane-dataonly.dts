// SPDX-License-Identifier: GPL-2.0+ OR MIT
/dts-v1/;
/plugin/;

/ {
	omarchy,data-only;
	omarchy,ane-soc = "t6030";
	omarchy,ane-generation = "H15";

	fragment@0 {
		target-path = "/";
		__overlay__ {
			omarchy_ane_data: omarchy-ane-data-t6030 {
				omarchy,data-only;
				compatible = "omarchy,ane-data-only";
				status = "disabled";
				ane-compatible = "iop,ascwrap-v6";
				ane-reg = <0x3 0x08000000 0x0 0x02000000>,
					  <0x3 0x50700000 0x0 0x00018000>;
				ane-interrupts = <559 558 561 560 576>;
				dart-compatible = "dart,t8110";
				dart-reg = <0x3 0x09800000 0x0 0x00004000>,
					   <0x3 0x09810000 0x0 0x00004000>,
					   <0x3 0x09820000 0x0 0x00004000>,
					   <0x3 0x09804000 0x0 0x00004000>;
				dart-interrupt = <577>;
				ane-type = <192>;
			};
		};
	};
};
