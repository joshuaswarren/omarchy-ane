/include/ "common.dtsi"
/ {
	mailbox@285408000 { compatible = "apple,t8103-m3-mailbox", "apple,m3-mailbox-v2"; reg = <0x2 0x85408000 0x0 0x4000>; interrupt-parent = <&aic>; #mbox-cells = <0>; interrupts = <0 884 4>; interrupt-names = "recv-not-empty"; };
};
